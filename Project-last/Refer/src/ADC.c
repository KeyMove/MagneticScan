#include"ADC.h"
static void init(){
	SETBIT(RCC->CFGR, RCC_CFGR_ADCPRE_1);
	SETBIT(RCC->APB2ENR,RCC_APB2ENR_ADC1EN|RCC_APB2ENR_IOPAEN);
	//GPIO_AF(GPIOA,00000000,00000000);
	ADC1->CR1=ADC1->CR2=0;
	
	CLRBIT(ADC1->SQR1, ADC_SQR1_L);

	SETBIT(ADC1->CR2, ADC_CR2_EXTSEL | ADC_CR2_EXTTRIG);
	SETBIT(ADC1->CR2, ADC_CR2_ADON);

	SETBIT(ADC1->CR2, ADC_CR2_RSTCAL);
	while (ADC1->CR2&ADC_CR2_RSTCAL);

	SETBIT(ADC1->CR2, ADC_CR2_CAL);
	while (ADC1->CR2&ADC_CR2_CAL);
	
	SETBIT(ADC1->CR2, ADC_CR2_ADON);
}

static u16 getADCValue(u8 ch) {
	u16 dat;
	//SETBIT(ADC1->CR1, ch & 0x1f);
	CLRBIT(ADC1->SQR3, ADC_SQR3_SQ1);
	SETBIT(ADC1->SQR3, ch&0x1f);
	SETBIT(ADC1->CR2, ADC_CR2_SWSTART);
	while (!(ADC1->SR&ADC_SR_EOC));
	dat = ADC1->DR;
	return dat;
}

const ADCBase ADC = {
	init,	
	getADCValue,
};
